## configs/sega_megadrive_defconfig
```kconfig
CONFIG_M68K=y
CONFIG_TEXT_BASE=0x0
CONFIG_SYS_MALLOC_LEN=0x100000
CONFIG_NR_DRAM_BANKS=1
CONFIG_ENV_SIZE=0x40000
CONFIG_DEFAULT_DEVICE_TREE="megadrive"
CONFIG_SYS_LOAD_ADDR=0x400
CONFIG_SYS_CLK_FREQ=8000000
CONFIG_ENV_ADDR=0x380000
CONFIG_TARGET_MEGADRIVE=y
# CONFIG_MCFTMR is not set
CONFIG_OF_BOARD_FIXUP=y
CONFIG_LTO=y
CONFIG_REMAKE_ELF=y
CONFIG_STACK_SIZE=0x20000
CONFIG_SYS_UBOOT_START=0x400
# CONFIG_TIMESTAMP is not set
# CONFIG_LEGACY_IMAGE_FORMAT is not set
CONFIG_SYS_CONSOLE_ENV_OVERWRITE=y
# CONFIG_CYCLIC is not set
CONFIG_BOARD_EARLY_INIT_R=y
CONFIG_STACKPROTECTOR=y
CONFIG_SYS_MAXARGS=16
# CONFIG_CMD_BOOTD is not set
# CONFIG_CMD_BOOTM is not set
# CONFIG_CMD_ELF_BOOTVX is not set
# CONFIG_CMD_IMI is not set
# CONFIG_CMD_XIMG is not set
# CONFIG_CMD_EXPORTENV is not set
# CONFIG_CMD_IMPORTENV is not set
# CONFIG_CMD_EDITENV is not set
# CONFIG_CMD_ENV_EXISTS is not set
# CONFIG_CMD_CRC32 is not set
CONFIG_CMD_UNLZ4=y
CONFIG_CMD_DM=y
# CONFIG_CMD_LOADS is not set
CONFIG_CMD_PART=y
# CONFIG_CMD_CLS is not set
CONFIG_CMD_RTC=y
CONFIG_DOS_PARTITION=y
CONFIG_EFI_PARTITION=y
CONFIG_OF_EMBED=y
CONFIG_NO_NET=y
CONFIG_DM_WARN=y
# CONFIG_DM_DEVICE_REMOVE is not set
# CONFIG_GPIO is not set
# CONFIG_I2C is not set
# CONFIG_INPUT is not set
# CONFIG_POWER is not set
CONFIG_DM_RTC=y
CONFIG_BAUDRATE=9600
CONFIG_SPECIFY_CONSOLE_INDEX=y
CONFIG_SERIAL_RX_BUFFER=y
CONFIG_SERIAL_SEARCH_ALL=y
CONFIG_VIDEO=y
# CONFIG_VIDEO_FONT_8X16 is not set
# CONFIG_VIDEO_LOGO is not set
# CONFIG_BACKLIGHT is not set
# CONFIG_VIDEO_BPP8 is not set
# CONFIG_VIDEO_BPP16 is not set
# CONFIG_VIDEO_BPP32 is not set
# CONFIG_CONSOLE_NORMAL is not set
CONFIG_CONSOLE_VDP=y
# CONFIG_PANEL is not set
# CONFIG_GZIP is not set
CONFIG_OF_LIBFDT_ASSUME_MASK=0
# CONFIG_TOOLS_KWBIMAGE is not set
```
